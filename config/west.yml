## config/west.yml
```yaml
manifest:
  remotes:
    - name: zmkfirmware
      url-base: https://github.com/zmkfirmware
    - name: badjeff
      url-base: https://github.com/badjeff
    - name: nuovotaka
      url-base: https://github.com/nuovotaka
    - name: george-norton
      url-base: https://github.com/george-norton

  projects:
    - name: zmk
      remote: zmkfirmware
      revision: v0.2
      import: app/west.yml
    - name: zmk-pmw3610-driver
      remote: badjeff
      revision: main
    - name: zmk-pointing-acceleration-alpha
      remote: nuovotaka
      revision: main
    - name: zmk-behavior-sensor-attr-cycle
      remote: george-norton
      revision: main
      
  self:
    path: config
```
